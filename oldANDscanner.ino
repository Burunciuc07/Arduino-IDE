#include <MFRC522.h>
#include <Adafruit_GFX.h>
#include <Adafruit_SSD1306.h>
#include <SPI.h>

// the project include: Oled, two Leds, rfid and tags
Adafruit_SSD1306 display(128, 64, &Wire, -1);

static const uint8_t  PROGMEM image[] = {    // Paste Image Byte Array
0xff, 0xff, 0xff, 0xff, 0xff, 0xff, 0xff, 0xff, 0xff, 0xff, 0xff, 0xff, 0xff, 0xff, 0xff, 0xff, 
  0xff, 0xff, 0xff, 0xff, 0xff, 0xff, 0xff, 0xff, 0xff, 0xff, 0xff, 0xff, 0xff, 0xff, 0xff, 0xff, 
  0xff, 0xff, 0xff, 0xff, 0xff, 0xff, 0xff, 0xff, 0xff, 0xff, 0xff, 0xff, 0xff, 0xff, 0xff, 0xff, 
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  0xbf, 0xff, 0xe0, 0x01, 0xef, 0xfd, 0xff, 0xf0, 0x1c, 0x07, 0xff, 0xff, 0xff, 0xff, 0xff, 0xff
};

static const uint8_t  PROGMEM craniu [] = {
  0xff, 0xff, 0xff, 0xff, 0xff, 0xff, 0xff, 0xff, 0xff, 0xff, 0xff, 0xff, 0xff, 0xff, 0xff, 0xff, 
  0xff, 0xff, 0xff, 0xff, 0xff, 0xff, 0xff, 0xe0, 0x07, 0xff, 0xff, 0xff, 0xff, 0xff, 0xff, 0xff, 
  0xff, 0xff, 0xff, 0xff, 0xff, 0xff, 0xfc, 0x00, 0x00, 0x3f, 0xff, 0xff, 0xff, 0xff, 0xff, 0xff, 
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  0xff, 0xff, 0xff, 0xff, 0xf0, 0x03, 0xff, 0xff, 0xff, 0xff, 0xc0, 0x0f, 0xff, 0xff, 0xff, 0xff
};

#define OLED_RESET A4
#define SS_PIN 10
#define RST_PIN 9

#define LED_PIN_RED 6
#define LED_PIN_GREEN 7
 
MFRC522 rfid(SS_PIN, RST_PIN); 

MFRC522::MIFARE_Key key; 

int code[] = {249,179,232,193}; //This is the stored UID
int codeRead = 0;
String uidString;
void setup() {
  
  Serial.begin(9600);
  SPI.begin(); 
  rfid.PCD_Init();  
  
  display.begin(SSD1306_SWITCHCAPVCC, 0x3C);  

  // Clear the buffer.
  display.clearDisplay();
  display.display();
  display.setTextColor(WHITE); 
  display.setTextSize(2);
  display.setCursor(10,0); 
  display.print("Cine esti");
  display.display();
}

void loop() {
  if(rfid.PICC_IsNewCardPresent())
  {
      readRFID();
  }
  delay(100);

}

void readRFID()
{
  
  rfid.PICC_ReadCardSerial();
  Serial.print(F("\nPICC type: "));
  MFRC522::PICC_Type piccType = rfid.PICC_GetType(rfid.uid.sak);
  Serial.println(rfid.PICC_GetTypeName(piccType));

 
  if (piccType != MFRC522::PICC_TYPE_MIFARE_MINI &&  
    piccType != MFRC522::PICC_TYPE_MIFARE_1K &&
    piccType != MFRC522::PICC_TYPE_MIFARE_4K) {
    Serial.println(F("Your tag is not of type MIFARE Classic."));
    return;
  }

    clearUID();
   
    Serial.println("Scanned PICC's UID:");
    printDec(rfid.uid.uidByte, rfid.uid.size);

    uidString = String(rfid.uid.uidByte[0])+" "+String(rfid.uid.uidByte[1])+" "+String(rfid.uid.uidByte[2])+ " "+String(rfid.uid.uidByte[3]);
    
  

    int i = 0;
    boolean match = true;
    while(i<rfid.uid.size)
    {
      if(!(rfid.uid.uidByte[i] == code[i]))
      {
           match = false;
      }
      i++;
    }
    
    if(match)
    {
      print1();
      delay(2000);
      display.clearDisplay();
      pinMode(LED_PIN_GREEN, OUTPUT);
      digitalWrite(LED_PIN_GREEN, HIGH);
      delay(5000);
      digitalWrite(LED_PIN_GREEN, LOW);
      printUnlockMessage();
      display.clearDisplay();
    }else
    {
      Serial.print("la ba");
      print2();
      delay(2000);
      display.clearDisplay();
      pinMode(LED_PIN_RED, OUTPUT);
  digitalWrite(LED_PIN_RED, HIGH);
  delay(5000);
  digitalWrite(LED_PIN_RED, LOW);
      printLockMessage();
      display.clearDisplay();
    }
    
    
  rfid.PICC_HaltA();

 
  rfid.PCD_StopCrypto1();
}

void printDec(byte *buffer, byte bufferSize) {
  for (byte i = 0; i < bufferSize; i++) {
    Serial.print(buffer[i] < 0x10 ? " 0" : " ");
    Serial.print(buffer[i], DEC);
  }
}

  void clearUID()
  {
    display.setTextColor(BLACK); 
    display.setTextSize(1);
    display.setCursor(30,20); 
  
    display.display();
  }

  void print1()
  {

    Serial.begin(115200);
    display.clearDisplay();
    display.drawBitmap(0, 0, image, 128, 64, 1);
    display.display();
    Serial.print("BLa nla ba");
  }
  void printUnlockMessage()
  {
    display.setTextColor(WHITE); 
    display.setTextSize(2);
    display.setCursor(10,0); 
    display.print("Unlocked");
    display.print("\nBuna David");//your message
    display.display();
  }

   void printLockMessage()
  {
    display.setTextColor(WHITE);
    display.setTextSize(2);
    display.setCursor(10,0); 
    display.print("Locked");
    display.print("\nTu nu esti David"); //your message 
    display.display();
  }
  void print2()
  {
    Serial.begin(115200);

    display.clearDisplay();
    display.drawBitmap(0, 0, craniu, 128, 64, 1);
    display.display();
  }
